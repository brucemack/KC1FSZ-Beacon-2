/*
 * Driver.cpp
 *
 *  Created on: Feb 22, 2020
 *      Author: Bruce MacKinnon KC1FSZ
 */

#include <stdio.h>
#include <math.h>
#include "Driver.h"

extern "C" {
#include "main.h"
#include "ssd1306.h"

#if defined(STM32F1)
#include "stm32f1xx_hal.h"
#endif
}

#include "VFOInterface.h"
#include "Debouncer.h"
#include "SystemEnv.h"
#include "RttyEncoder.h"
#include "WsprEncoder.h"

// This is needed to enable communication with the Si5351/a
#include "STM32_HAL_Interface.h"
// Ehterkit library (with modifications)
#include "si5351.h"

// ----------------------------------------------------------------------------
// Get the system environment hooked up
class SystemEnv1 : public kc1fsz::SystemEnv {
public:

	uint32_t getTimeMs() {
		return HAL_GetTick();
	}
};
static SystemEnv1 sysenv1;

// ----------------------------------------------------------------------------
// Wrap the I2C interface so that the Si5351 library can talk to it
extern I2C_HandleTypeDef hi2c1;
static STM32_HAL_Interface i2c_interface(&hi2c1);
static Si5351 si5351(0x60, &i2c_interface);

// ----------------------------------------------------------------------------
// Wrap the SI5351 in the VFOInterface so that the encoders
// can talk to it.
class VFO1 : public kc1fsz::VFOInterface {
public:

	void setOutputEnabled(bool e) {
		if (e != _enabled) {
			_enabled = e;
			if (e) {
				 si5351.set_clock_pwr(SI5351_CLK0, 1);
			} else {
				// This is how the Etherkit demo turn off the output
				si5351.set_clock_pwr(SI5351_CLK0, 0);
			}
		}
	}

	void setFrequency(double freqHz) {
		unsigned long long f = freqHz;
		_freq = f * 100ULL;
		si5351.set_freq(_freq, SI5351_CLK0);
	}

private:

	bool _enabled = false;
	unsigned long long _freq;
};

static VFO1 vfo1;

// ----------------------------------------------------------------------------
// Wrap the LED in the status indicator interface
class Ind1 : public kc1fsz::StatusIndicator {
public:
	void setLight(bool s) {
		if (s) {
			HAL_GPIO_WritePin(LED_GPIO_Port, LED_Pin, GPIO_PIN_SET);
		} else {
			HAL_GPIO_WritePin(LED_GPIO_Port, LED_Pin, GPIO_PIN_RESET);
		}
	}
	/**
	 * Render a short message on the top right of the display
	 */
	void setMessage(const char* msg) {
		char buf[9];
		int i;
		for (i = 0; i < 8 && msg[i] != 0; i++)
			buf[i] = msg[i];
		for (;i < 8; i++)
			buf[i] = ' ';
		buf[i] = 0;
		ssd1306_SetCursor(64, 0);
		ssd1306_WriteString(buf, Font_7x10, White);
		ssd1306_UpdateScreen();
	}
};
static Ind1 ind1;

// ----------------------------------------------------------------------------
// Switch de-bouncing
static kc1fsz::Debouncer but0(&sysenv1, 20);

// ----------------------------------------------------------------------------
// Get the encoder integrated with the hardware
//static kc1fsz::RttyEncoder encoder(&sysenv1, &vfo1, &ind1);
static kc1fsz::WsprEncoder encoder(&sysenv1, &vfo1, &ind1);

// RTTY
//static const unsigned int freq = 7040000;
// WSPR
static unsigned int freq = 7038600;

// Bulletin message
static const char* msg =
"\r\n"
"\r\n"
"\r\n"
"\r\n"
"\r\n"
"\r\n"
"\r\n"
"\r\n"
"\r\n"
"\r\n"
"DE DE DE KC1FSZ KC1FSZ KC1FSZ\r\n"
"DE DE DE KC1FSZ KC1FSZ KC1FSZ\r\n"
"\r\n"
"QST QST QST\r\n"
"BE ADVISED THAT THE NE SCI TECH AMATEUR RADIO CLUB (STARS) WILL BE HOLDING\r\n"
"ITS MONTHLY MEETING ON 10 MAR 2020 AT 1900 EST (11 MAR 0000Z)\r\n"
"AT NEW ENGLAND SCI-TECH. ALL ARE WELCOME!\r\n"
"ADDRESS IS 16 TECH CIRCLE, NATICK, MA.\r\n"
"GRID SQUARE FN42HH.\r\n"
"\r\n"
"UPDATES TO FOLLOW AS THEY ARE AVAILABLE.\r\n"
"\r\n"
"DE DE DE KC1FSZ FC1FSZ KC1FSZ\r\n"
"THIS TRANSMISSION WAS GENERATED BY AN RTTY BEACON WITH 1.5W PEP OUTPUT POWER.\r\n"
"\r\n"
"SK\r\n"
"\r\n"
"\r\n"
"\r\n"
"\r\n"
"\r\n";

static void Driver_displayFreq(unsigned int freq) {
	char buf[32];
	int x = 50;
	// Print whole KHz
	sprintf(buf,"%5d",freq / 1000);
	ssd1306_SetCursor(x, 12);
	ssd1306_WriteString(buf, Font_11x18, White);
	// Print 100Hz increments
	sprintf(buf,".%d",(freq % 1000) / 100);
	ssd1306_SetCursor(x + 55, 12);
	ssd1306_WriteString(buf, Font_11x18, White);
	ssd1306_UpdateScreen();
}

void Driver_init() {

	// Initialize the Si5351/A
	si5351.init(SI5351_CRYSTAL_LOAD_8PF, 0, 0);

	// Initialize the display
	ssd1306_Init();
	ssd1306_Fill(Black);
	// Logo
	ssd1306_SetCursor(0, 0);
	ssd1306_WriteString((char*)"KC1FSZ", Font_7x10, White);
	for (int x = 0; x < 128; x++)
		ssd1306_DrawPixel(x, 10, White);
	ssd1306_UpdateScreen();

	Driver_displayFreq(freq);

	// Set the transmit frequency
	encoder.setFreq(freq);

	// Setup the message to be broadcast on the
	//encoder.queueMessage(msg);
	//encoder.setLoop(true);
	// Setup parameters for WSPR
	// 24 dBm = 0.25 watts, 10 Vpp into a 50 ohm load
	encoder.setOffsetFreq(1500);
	encoder.setParameters("KC1FSZ","FN42",24);
	encoder.start();
}

long lastStrobe = 0;

void Driver_loop() {

	encoder.poll();

	// Button press creates a low signal (pull-up resistor needed)
	if (HAL_GPIO_ReadPin(BUT0_GPIO_Port, BUT0_Pin)) {
		but0.loadSample(false);
	} else {
		// True when low
		but0.loadSample(true);
	}

	if (but0.isEdge()) {
		if (but0.getState()) {
			// Reset time on all presses
			encoder.start();
		} else {
			// Look for a long press
			if (but0.getHighMs() > 2000) {
				freq = 28124600;
				Driver_displayFreq(freq);
				encoder.setFreq(freq);
				encoder.start();
			}
		}
	}
}
